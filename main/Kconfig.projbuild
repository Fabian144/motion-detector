## main/Kconfig.projbuild
```kconfig
menu "GPIO Configuration"
    choice CHIP_TYPE
        prompt "Select chip type"
        default TYPE_DHT11

        config TYPE_DHT11
            bool "DHT11"
        config TYPE_AM2301
            bool "DHT21/DHT22/AM2301/AM2302/AM2321"
        config TYPE_SI7021
            bool "Itead Si7021"
    endchoice

    config HYGRO_GPIO
        int "Hygrothermograph data GPIO number"
        default 4 if IDF_TARGET_ESP8266
        default 4 if IDF_TARGET_ESP32C2 || IDF_TARGET_ESP32C3 || IDF_TARGET_ESP32C5 || IDF_TARGET_ESP32C6 || IDF_TARGET_ESP32C61
        default 4 if IDF_TARGET_ESP32H2
        default 4 if IDF_TARGET_ESP32P4
        default 5 if IDF_TARGET_ESP32 || IDF_TARGET_ESP32S2 || IDF_TARGET_ESP32S3
        help
            GPIO number connected to DATA pin.

    config INTERNAL_PULLUP
        bool "Enable internal pull-up resistor"
        default 0
        help
						Check this option if you don't have external pull-up resistor on data GPIO.
						DHT sensors that come mounted on a PCB generally have pull-up resistors on the data pin.
						But for stable operation, it is recommended to provide an external pull-up resistor.

		config TRIGGER_GPIO
        int "Trigger GPIO number"
        default 4 if IDF_TARGET_ESP8266
        default 4 if IDF_TARGET_ESP32C2 || IDF_TARGET_ESP32C3 || IDF_TARGET_ESP32C5 || IDF_TARGET_ESP32C6 || IDF_TARGET_ESP32C61
        default 4 if IDF_TARGET_ESP32H2
        default 4 if IDF_TARGET_ESP32P4
        default 13 if IDF_TARGET_ESP32 || IDF_TARGET_ESP32S2 || IDF_TARGET_ESP32S3
        help
            GPIO number for TRIGGER pin of ultrasonic module.

    config ECHO_GPIO
				int "Echo GPIO number"
				default 5 if IDF_TARGET_ESP8266 || IDF_TARGET_ESP32C3
				default 5 if IDF_TARGET_ESP32C2 || IDF_TARGET_ESP32C3 || IDF_TARGET_ESP32C5 || IDF_TARGET_ESP32C6 || IDF_TARGET_ESP32C61
				default 5 if IDF_TARGET_ESP32H2
				default 5 if IDF_TARGET_ESP32P4
				default 27 if IDF_TARGET_ESP32 || IDF_TARGET_ESP32S2 || IDF_TARGET_ESP32S3
				help
						GPIO number for ECHO pin of ultrasonic module.

    config MAX_DISTANCE
				int "Maximal distance, cm"
				default 500
				help
						Maximum measurable distance. If the distance is greater than this parameter, there will be a timeout.

		config POTENTIOMETER_GPIO
			int "Potentiometer GPIO number"
			default 4
			help
					GPIO number for the potentiometer.

		config BUZZER_GPIO
			int "Passive piezo buzzer GPIO number"
			default 18
			help
					GPIO number for the passive piezo buzzer.

		config ESP_I2C_PORT
			int "ESP I2C Controller"
			default 0
			help
				Number of the I2C Controller to use (usually 0 or 1).

			config ESP_I2C_SDA
			int "ESP I2C"
			default 21
			help
				GPIO number to use for ESP I2C SDA.

			config ESP_I2C_SCL
			int "I2C Controller"
			default 22
			help
				GPIO number to use for ESP I2C SCL.
endmenu
```
